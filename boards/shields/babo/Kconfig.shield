## boards/shields/babo/Kconfig.shield
```kconfig
# Copyright (c) 2020 Pete Johanson
# SPDX-License-Identifier: MIT

config SHIELD_BABO_LEFT
    def_bool $(shields_list_contains,babo_left)

config SHIELD_BABO_RIGHT
    def_bool $(shields_list_contains,babo_right)
```
